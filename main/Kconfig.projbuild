## main/Kconfig.projbuild
```kconfig
menu "PrecisionShot diagnostics"
    config PRECISIONSHOT_SELF_TEST
        bool "Run UI/session tests and capture screen frames at startup"
        default n
        help
            Diagnostic build only. Exercises UI actions and dumps framebuffer
            snapshots over USB before restoring the initial session. Disable
            for normal device use.
endmenu
```

## sdkconfig.defaults
```kconfig
CONFIG_IDF_TARGET="esp32s3"
CONFIG_ESPTOOLPY_FLASHMODE_DIO=y
CONFIG_ESPTOOLPY_FLASHSIZE_8MB=y
CONFIG_PARTITION_TABLE_SINGLE_APP=y
CONFIG_ESP_CONSOLE_USB_SERIAL_JTAG=y
CONFIG_ESP_MAIN_TASK_STACK_SIZE=8192
CONFIG_ESP_DEFAULT_CPU_FREQ_MHZ_240=y
# Retain the existing BLE identity (factory base MAC + 1).
CONFIG_ESP32S3_UNIVERSAL_MAC_ADDRESSES_TWO=y
CONFIG_FREERTOS_HZ=1000
CONFIG_BT_ENABLED=y
CONFIG_BT_BLUEDROID_ENABLED=y
CONFIG_BT_BLE_42_FEATURES_SUPPORTED=y
# CONFIG_BT_BLE_50_FEATURES_SUPPORTED is not set
CONFIG_BT_GATTS_ENABLE=y
# CONFIG_BT_GATTC_ENABLE is not set
```
